## Kconfig
```kconfig
# SPDX-License-Identifier: MIT
# Extras for the 60% keyboard on the S2 mini: knob with modes, Raw HID with PC data, custom screen.

config S2MINI_KNOB_MODES
    bool "Knob with modes (&knob, &knob_next)"
    default y
    depends on DT_HAS_ZMK_BEHAVIOR_KNOB_MODES_ENABLED

config S2MINI_RAW_HID
    bool "Raw HID: data from the PC for the screen"
    depends on ZMK_USB_NEXT && USBD_HID_SUPPORT
    help
      Second HID interface (usage page 0xFF60, 32 B reports). Needs a zephyr,hid-device node
      selected with chosen s2mini,raw-hid.

config S2MINI_RAW_HID_INIT_PRIORITY
    int "Raw HID init priority"
    default 94
    depends on S2MINI_RAW_HID

config S2MINI_STATUS_SCREEN
    bool "S2 mini 60% screen (layer, knob, data from the PC)"
    depends on ZMK_DISPLAY_STATUS_SCREEN_CUSTOM
    select LV_USE_LABEL
    select LV_USE_THEME_MONO

config S2MINI_STATUS_PC_TIMEOUT_MS
    int "Milliseconds without PC data before the screen shows 'no data from PC'"
    default 5000
    depends on S2MINI_STATUS_SCREEN
```

## boards/shields/s2mini_60/Kconfig.defconfig
```kconfig
if SHIELD_S2MINI_60

config ZMK_KEYBOARD_NAME
    default "S2 mini 60"

config ZMK_USB
    default y

config ZMK_USB_NEXT
    default y

endif
```

## boards/shields/s2mini_zmk_test/Kconfig.defconfig
```kconfig
if SHIELD_S2MINI_ZMK_TEST

config ZMK_KEYBOARD_NAME
    default "S2 mini ZMK test"

config ZMK_USB
    default y

config ZMK_USB_NEXT
    default y

endif
```

## boards/shields/s2mini_zmk_test/Kconfig.shield
```kconfig
config SHIELD_S2MINI_ZMK_TEST
    def_bool $(shields_list_contains,s2mini_zmk_test)
```

## dts/bindings/behaviors/zmk,behavior-knob-modes.yaml
```yaml
# SPDX-License-Identifier: MIT
description: |
  Knob with several modes. Each mode is a separate sensor behavior (e.g. sensor-rotate);
  &knob_next changes the active mode. Mode names are shown on the screen.

compatible: "zmk,behavior-knob-modes"

include: behavior-metadata.yaml

properties:
  "#sensor-binding-cells":
    type: int
    required: true
    const: 0
  modes:
    type: phandles
    required: true
    description: Sensor behaviors for the modes, in order.
  mode-names:
    type: string-array
    required: true
    description: Mode names shown on the screen (same count as modes).
```

## dts/bindings/behaviors/zmk,behavior-knob-next.yaml
```yaml
# SPDX-License-Identifier: MIT
description: Switches the knob to the next mode (see zmk,behavior-knob-modes).

compatible: "zmk,behavior-knob-next"

include: zero_param.yaml
```

## dts/bindings/behaviors/zmk,behavior-screen-view.yaml
```yaml
# SPDX-License-Identifier: MIT
description: Switches the screen view (SCR_PREV / SCR_NEXT from dt-bindings/zmk/s2mini.h).

compatible: "zmk,behavior-screen-view"

include: one_param.yaml
```

## dts/bindings/sensor/s2mini,ec11-poll.yaml
```yaml
# SPDX-License-Identifier: MIT
description: |
  EC11 rotary encoder read by polling (every 1 ms) instead of GPIO interrupts.
  A step is counted only after a whole detent (click), so contact bounce cannot lose or add steps.
  Reports rotation like alps,ec11 (degrees from "steps"), so zmk,keymap-sensors works unchanged.

compatible: "s2mini,ec11-poll"

properties:
  a-gpios:
    type: phandle-array
    required: true
  b-gpios:
    type: phandle-array
    required: true
  steps:
    type: int
    required: true
    description: Pulses (A/B state changes) per full rotation, e.g. 80 for a 20-click EC11.
  pulses-per-detent:
    type: int
    default: 4
    description: A/B state changes between two clicks (4 for a 20-click / 20-pulse EC11).
  poll-period-us:
    type: int
    default: 1000
    description: How often A/B are read.
```
